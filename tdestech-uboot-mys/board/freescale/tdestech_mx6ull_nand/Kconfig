## tdestech-uboot-mys/board/freescale/tdestech_mx6ull_nand/Kconfig
```kconfig
if TARGET_TDESTECH_MX6ULL_NAND

config SYS_BOARD
	default "tdestech_mx6ull_nand"

config SYS_VENDOR
	default "freescale"

config SYS_SOC
	default "mx6"

config SYS_CONFIG_NAME
	default "tdestech_mx6ull_nand"

endif
```

## tdestech-uboot-mys/configs/tdestech_mx6ull_nand_defconfig
```kconfig
CONFIG_SYS_EXTRA_OPTIONS="IMX_CONFIG=board/freescale/tdestech_mx6ull_nand/imximage.cfg,SYS_BOOT_NAND"
CONFIG_ARM=y
CONFIG_ARCH_MX6=y
CONFIG_TARGET_TDESTECH_MX6ULL_NAND=y
CONFIG_CMD_GPIO=y
```
